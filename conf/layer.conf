## conf/layer.conf
```bitbake
# We have a conf and classes directory, add to BBPATH
BBPATH .= ":${LAYERDIR}"

# We have recipes-* directories, add to BBFILES
BBFILES += "${LAYERDIR}/recipes-*/*/*.bb ${LAYERDIR}/recipes-*/*/*.bbappend"


BBFILE_COLLECTIONS += "meta-polarfire-soc-yocto-bsp"
BBFILE_PATTERN_meta-polarfire-soc-yocto-bsp = "^${LAYERDIR}/"
BBFILE_PRIORITY_meta-polarfire-soc-yocto-bsp = "1"

# This should only be incremented on significant changes that will
# cause compatibility issues with other layers
LAYERVERSION_meta-polarfire-soc-yocto-bsp = "1"

LAYERDEPENDS_meta-polarfire-soc-yocto-bsp = "core"
LAYERDEPENDS_meta-polarfire-soc-yocto-bsp += "riscv-layer"
LAYERDEPENDS_meta-polarfire-soc-yocto-bsp += "openembedded-layer"

LAYERSERIES_COMPAT_meta-polarfire-soc-yocto-bsp = "gatesgarth hardknott honister"
```

## conf/machine/icicle-kit-es-amp.conf
```bitbake
#@TYPE: Machine
#@NAME: icicle-kit-es-amp
#@SOC: Polarfire SoC
#@DESCRIPTION: Machine configuration for the Microchip Polarfire SoC, Icicle Kit Engineering Sample in AMP mode

require include/mpfs-common-machine-configuration.inc
require include/qspi-flash-nand.inc

MACHINE_TYPE = "amp"

RISCV_SBI_FDT ?=  "mpfs-icicle-kit-context-a.dtb"
KERNEL_DTC_FLAGS += "-@"
KERNEL_DEVICETREE ?= "microchip/${RISCV_SBI_FDT}"

UBOOT_CONFIG = "mpfs_icicle"
UBOOT_CONFIG[mpfs_icicle] = "microchip_mpfs_icicle_amp_defconfig"

## Set this to "mmc-tftp" to generate a boot.scr file which should be included
##  in the boot partition. It will try to load a kernel image from mmc and fall back to tftp
UBOOT_ENV = "tftp-mmc"

## Select the YAML file used for building the HSS payload
HSS_PAYLOAD = "amp"

## Set this to "freertos" for a Linux + FreeRTOS demo or "bm" for a Linux + Bare Metal demo
AMP_DEMO = "freertos"
#AMP_DEMO = "bm"

IMAGE_INSTALL:append = " polarfire-soc-amp-examples"

IMAGE_CLASSES:append = " image_type_mtd"

IMAGE_BOOT_FILES ?= " \
    fitImage \
    boot.scr.uimg \
"

WKS_FILE ?= "mpfs-rootfs.wks"

MACHINEOVERRIDES =. " icicle-kit:"
```

## conf/machine/icicle-kit-es-auth.conf
```bitbake
#@TYPE: Machine
#@NAME: icicle-kit-es-auth
#@SOC: Polarfire SoC
#@DESCRIPTION: Machine configuration for the Microchip Polarfire SoC, Icicle Kit Engineering Sample Authenticated boot

require conf/machine/include/riscv/tune-riscv.inc
require include/authenticated-boot.inc

MACHINE_FEATURES = "screen keyboard ext2 ext3 serial"
MACHINE_TYPE = "smp"

KERNEL_CLASSES = "kernel-fitimage"
KERNEL_IMAGETYPE = "fitImage"
EXTERNAL_KERNEL_DEVICETREE = "${DEPLOY_DIR_IMAGE}/overlays"

RISCV_SBI_FDT ?=  "mpfs-icicle-kit.dtb"
KERNEL_DTC_FLAGS += "-@"
KERNEL_DEVICETREE ?= "microchip/${RISCV_SBI_FDT}"
KBUILD_DEFCONFIG ?= "mpfs_defconfig"

PREFERRED_PROVIDER_virtual/kernel ?= "mpfs-linux"

PREFERRED_VERSION_openocd-native = "riscv"
PREFERRED_VERSION_openocd = "riscv"

PREFERRED_PROVIDER_virtual/bootloader = "u-boot-mpfs"
PREFERRED_PROVIDER_u-boot = "u-boot-mpfs"

## Set this to "mpfs_icicle" to use a nand flash as the default external flash memory
## Set this to "mpfs_icicle_nor" to use a nor flash as the default external flash memory
## Note: If no external flash memory is found, U-boot will try to boot from SD/emmc 
## or fallback to tftp

UBOOT_CONFIG = "mpfs_icicle"
UBOOT_CONFIG[mpfs_icicle] = "microchip_mpfs_icicle_defconfig"
UBOOT_CONFIG[mpfs_icicle_nor] = "microchip_mpfs_icicle_qspi_nor_defconfig"

INCLUDES += "${@bb.utils.contains('UBOOT_CONFIG', 'mpfs_icicle', \
' include/qspi-flash-nand.inc', ' include/qspi-flash-nor.inc', d)}"
require ${INCLUDES}

UBOOT_ENTRYPOINT = "0x80200000"
UBOOT_DTB_LOADADDRESS = "0x8a000000"
UBOOT_DTBO_LOADADDRESS = "0x8a080000"
UBOOT_DTBO_OFFSET = "0x00010000"
UBOOT_RD_LOADADDRESS = "0x8aa00000"
UBOOT_RD_ENTRYPOINT = "0x8aa00000"

HSS_PAYLOAD = "uboot"

MACHINE_EXTRA_RRECOMMENDS += " kernel-modules"

IMAGE_FSTYPES += "wic wic.gz wic.bmap ext4"
IMAGE_CLASSES:append = " image_type_mtd"

## Do not update fstab file when using wic images
WIC_CREATE_EXTRA_ARGS ?= "--no-fstab-update"

## wic default support
WKS_FILE_DEPENDS ?= " \
    e2fsprogs-native \
    bmap-tools-native \
    u-boot-mpfs \
"

IMAGE_BOOT_FILES ?= " \
    fitImage \
"

WKS_FILE ?= "mpfs-rootfs.wks"
```

## conf/machine/icicle-kit-es.conf
```bitbake
#@TYPE: Machine
#@NAME: icicle-kit-es
#@SOC: Polarfire SoC
#@DESCRIPTION: Machine configuration for the Microchip Polarfire SoC, Icicle Kit Engineering Sample

require include/mpfs-common-machine-configuration.inc

MACHINE_TYPE = "smp"

RISCV_SBI_FDT ?=  "mpfs-icicle-kit.dtb"
KERNEL_DTC_FLAGS += "-@"
KERNEL_DEVICETREE ?= "microchip/${RISCV_SBI_FDT}"

## Set this to "mpfs_icicle" to use a nand flash as the default external flash memory
## Set this to "mpfs_icicle_nor" to use a nor flash as the default external flash memory
## Note: If no external flash memory is found, U-boot will try to boot from SD/emmc 
## or fallback to tftp

UBOOT_CONFIG = "mpfs_icicle"
UBOOT_CONFIG[mpfs_icicle] = "microchip_mpfs_icicle_defconfig"
UBOOT_CONFIG[mpfs_icicle_nor] = "microchip_mpfs_icicle_qspi_nor_defconfig"

INCLUDES += "${@bb.utils.contains('UBOOT_CONFIG', 'mpfs_icicle', \
' include/qspi-flash-nand.inc', ' include/qspi-flash-nor.inc', d)}"
require ${INCLUDES}


## Set this to "mmc-tftp" to generate a boot.scr file which should be included
##  in the boot partition. It will try to load a kernel image from mmc and fall back to tftp
UBOOT_ENV = "tftp-mmc"

HSS_PAYLOAD = "uboot"

IMAGE_CLASSES:append = " image_type_mtd"

IMAGE_BOOT_FILES ?= " \
    fitImage \
    boot.scr.uimg \
"

WKS_FILE ?= "mpfs-rootfs.wks"
```

## conf/machine/include/authenticated-boot.inc
```bitbake
UBOOT_SIGN_ENABLE = "1"
UBOOT_SIGN_KEYNAME ?= "mpfs_fitimage_key"
UBOOT_SIGN_KEYDIR ?= "${TOPDIR}/../keys"
UBOOT_MKIMAGE_DTCOPTS = "-I dts -O dtb -p 2000"
FIT_SIGN_ALG = "rsa4096"
FIT_HASH_ALG = "sha256"

HSS_PAYLOAD_PRIVATE_KEYNAME ?= "x509-ec-secp384r1-private"
HSS_PAYLOAD_KEYDIR ?= "${TOPDIR}/../keys"
```

## conf/machine/include/mpfs-common-machine-configuration.inc
```bitbake
#@TYPE: Machine Include
#@SOC: Polarfire SoC
#@DESCRIPTION: Common Machine Configuration for Polarfire SoC

require conf/machine/include/riscv/tune-riscv.inc

MACHINE_FEATURES = "screen keyboard ext2 ext3 serial"

KERNEL_CLASSES = "kernel-fitimage"
KERNEL_IMAGETYPE = "fitImage"
EXTERNAL_KERNEL_DEVICETREE = "${DEPLOY_DIR_IMAGE}/overlays"

KBUILD_DEFCONFIG ?= "mpfs_defconfig"

PREFERRED_PROVIDER_virtual/kernel ?= "mpfs-linux"
PREFERRED_VERSION_openocd-native = "riscv"
PREFERRED_VERSION_openocd = "riscv"
PREFERRED_PROVIDER_virtual/bootloader = "u-boot-mpfs"
PREFERRED_PROVIDER_u-boot = "u-boot-mpfs"

UBOOT_ENTRYPOINT = "0x80200000"
UBOOT_DTB_LOADADDRESS = "0x8a000000"
UBOOT_DTBO_LOADADDRESS = "0x8a080000"
UBOOT_RD_LOADADDRESS = "0x8aa00000"
UBOOT_RD_ENTRYPOINT = "0x8aa00000"

MACHINE_EXTRA_RRECOMMENDS += " kernel-modules"

IMAGE_FSTYPES += "wic wic.gz wic.bmap ext4"

## Do not update fstab file when using wic images
WIC_CREATE_EXTRA_ARGS ?= "--no-fstab-update"

## wic default support
WKS_FILE_DEPENDS ?= " \
    e2fsprogs-native \
    bmap-tools-native \
    u-boot-mpfs \
"
```

## conf/machine/include/qspi-flash-nand.inc
```bitbake
# UBIFS for Mikroe FLash 5 Click (128 MB)
MKUBIFS_ARGS ?= " -e 126976 -c 926 -m 2048 -x zlib -F"
UBINIZE_ARGS ?= " -m 2048 -p 128KiB -s 2048"
MKENVIMAGE_EXTRA_ARGS = " -r "

MPFS_MTDPARTS = "spi2.0:2m(payload),128k(env),119m(rootfs)"
MPFS_IS_ON_MTDID = "spi2.0"
MPFS_MTD_TYPE = "nand"
UBI_VOLNAME = "rootfs"
```

## conf/machine/include/qspi-flash-nor.inc
```bitbake
# UBIFS for PMOD SF3 NOR FLash + Pmod HAT Adapter (32 MB)
MKUBIFS_ARGS ?= " -e 65408 -c 422 -m 1 -x zlib"
UBINIZE_ARGS ?= " -m 1 -p 64KiB"
MKENVIMAGE_EXTRA_ARGS = " -r "

MPFS_MTDPARTS = "spi2.0:2m(payload),128k(env),28m(rootfs)"
MPFS_IS_ON_MTDID = "spi2.0"
MPFS_MTD_TYPE = "nor"
UBI_VOLNAME = "rootfs"
```

## conf/machine/mpfs-video-kit.conf
```bitbake
#@TYPE: Machine
#@NAME: mpfs-video-kit
#@SOC: Polarfire SoC
#@DESCRIPTION: Machine configuration for the Microchip Polarfire SoC Video Kit

require include/mpfs-common-machine-configuration.inc
MACHINE_TYPE = "smp"

RISCV_SBI_FDT ?=  "mpfs-video-kit.dtb"
KERNEL_DTC_FLAGS += "-@"
KERNEL_DEVICETREE ?= "microchip/${RISCV_SBI_FDT}"

UBOOT_MACHINE="microchip_mpfs_videokit_defconfig"
UBOOT_DEVICE_TREE ?= "mpfs_video.dtb"

UBOOT_ENTRYPOINT = "0x80200000"
UBOOT_DTB_LOADADDRESS = "0x8a000000"
UBOOT_DTBO_LOADADDRESS = "0x8a080000"
UBOOT_DTBO_OFFSET = "0x00010000"
UBOOT_RD_LOADADDRESS = "0x8aa00000"
UBOOT_RD_ENTRYPOINT = "0x8aa00000"

## Set this to "mmc-tftp" to generate a boot.scr file which should be included
##  in the boot partition. It will try to load a kernel image from mmc and fall back to tftp
UBOOT_ENV = "tftp-mmc"

HSS_PAYLOAD = "uboot"

IMAGE_BOOT_FILES ?= " \
    fitImage \
    boot.scr.uimg \
"

WKS_FILE ?= "mpfs-rootfs.wks"
```

## conf/machine/mpfs.conf
```bitbake
#@TYPE: Machine
#@NAME: mpfs
#@SOC: Polarfire SoC
#@DESCRIPTION: Machine configuration for the Microchip Polarfire SoC, Aloevera

require conf/machine/include/riscv/tune-riscv.inc

MACHINE_FEATURES = "screen keyboard ext2 ext3 serial"

KERNEL_CLASSES = "kernel-fitimage"
KERNEL_IMAGETYPE = "fitImage"
KERNEL_DEVICETREE ?= "sifive/${RISCV_SBI_FDT}"


PREFERRED_PROVIDER_virtual/kernel ?= "mpfs-linux"
GDBVERSION = "riscv"
PREFERRED_VERSION_openocd-native = "riscv"
PREFERRED_VERSION_openocd = "riscv"

UBOOT_MACHINE="mpfs_defconfig"
EXTRA_IMAGEDEPENDS += "u540-c000-bootloader opensbi"
PREFERRED_PROVIDER_virtual/bootloader = "u-boot"
UBOOT_ENTRYPOINT = "0x80200000"
UBOOT_DTB_LOADADDRESS = "0x82200000"


## Set this to "mmc-boot" to generate a boot.scr file which should be included
##  in the boot partition. It will try to load a kernel image by TFTP and if that
##  fails it will fall back to local images in the boot partition.
UBOOT_ENV ?= "tftp-mmc-boot"

## This sets u-boot as the default OpenSBI payload
RISCV_SBI_PAYLOAD ?= "u-boot.bin"
RISCV_SBI_PLAT = "sifive/fu540"
RISCV_SBI_FDT ?=  "mpfs.dtb"

SERIAL_CONSOLES = "115200;ttySIF0"

MACHINE_EXTRA_RRECOMMENDS += " kernel-modules"

IMAGE_FSTYPES += "wic.gz ext4"
IMAGE_INSTALL_append = " u-boot"

## Do not update fstab file when using wic images
WIC_CREATE_EXTRA_ARGS ?= "--no-fstab-update"

## wic default support
WKS_FILE_DEPENDS ?= " \
    opensbi \
    u540-c000-bootloader \
    e2fsprogs-native \
    bmap-tools-native \
"

IMAGE_BOOT_FILES ?= " \
    fw_payload.bin \
    fsbl.bin \
    fitImage \
    boot.scr.uimg \
"

WKS_FILE ?= "mpfs-fsbl-opensbi.wks"

BAD_RECOMMENDATIONS += "\
    libcxx-dev \
    libcxx-staticdev \
    compiler-rt-dev \
    compiler-rt-staticdev \
"
ASSUME_PROVIDED += "\
    libcxx-dev \
    libcxx-staticdev \
    compiler-rt-dev \
    compiler-rt-staticdev \
"
```

## conf/machine/sev-kit-es.conf
```bitbake
#@TYPE: Machine
#@NAME: sev-kit-es
#@SOC: Polarfire SoC
#@DESCRIPTION: Machine configuration for the Microchip Polarfire SoC, SEV Kit Engineering Sample

require conf/machine/include/riscv/tune-riscv.inc

MACHINE_FEATURES = "screen keyboard ext2 ext3 serial"
MACHINE_TYPE = "smp"

KERNEL_CLASSES = "kernel-fitimage"
KERNEL_IMAGETYPE = "fitImage"
EXTERNAL_KERNEL_DEVICETREE = "${DEPLOY_DIR_IMAGE}/overlays"

RISCV_SBI_FDT ?=  "mpfs-sev-kit.dtb"
KERNEL_DTC_FLAGS += "-@"
KERNEL_DEVICETREE ?= "microchip/${RISCV_SBI_FDT}"
KBUILD_DEFCONFIG ?= "mpfs_defconfig"

PREFERRED_PROVIDER_virtual/kernel ?= "mpfs-linux"

PREFERRED_VERSION_openocd-native = "riscv"
PREFERRED_VERSION_openocd = "riscv"

UBOOT_MACHINE="microchip_mpfs_sevkit_defconfig"
PREFERRED_PROVIDER_virtual/bootloader = "u-boot"
UBOOT_DEVICE_TREE ?= "mpfs_sev.dtb"
UBOOT_ENTRYPOINT = "0x10 0x00200000"
UBOOT_DTB_LOADADDRESS = "0x10 0x02200000"
UBOOT_DTBO_LOADADDRESS = "0x10 0x02300000"

## Set this to "mmc-tftp" to generate a boot.scr file which should be included
##  in the boot partition. It will try to load a kernel image from mmc and fall back to tftp
UBOOT_ENV = "tftp-mmc"

HSS_PAYLOAD = "uboot"

SERIAL_CONSOLES = "115200;ttySIF0"

MACHINE_EXTRA_RRECOMMENDS += " kernel-modules"

IMAGE_FSTYPES += "wic wic.gz wic.bmap ext4"

## Nand flash configuration
MPFS_MTDPARTS = "spi-nand0:8m(payload),128k(env),48m(fitimage)"
MPFS_IS_ON_MTDID = "spi-nand0"
IMAGE_CLASSES:append = " image_type_mtd"

## Do not update fstab file when using wic images
WIC_CREATE_EXTRA_ARGS ?= "--no-fstab-update"

## wic default support
WKS_FILE_DEPENDS ?= " \
    e2fsprogs-native \
    bmap-tools-native \
    u-boot \
"

IMAGE_BOOT_FILES ?= " \
    fitImage \
    boot.scr.uimg \
"

WKS_FILE ?= "mpfs-rootfs.wks"
```

## meta-polarfire-soc-bsp/conf/layer.conf
```bitbake
# We have a conf and classes directory, add to BBPATH
BBPATH .= ":${LAYERDIR}"

# We have recipes-* directories, add to BBFILES
BBFILES += "${LAYERDIR}/recipes-*/*/*.bb ${LAYERDIR}/recipes-*/*/*.bbappend"


BBFILE_COLLECTIONS += "meta-polarfire-soc-bsp"
BBFILE_PATTERN_meta-polarfire-soc-bsp = "^${LAYERDIR}/"
BBFILE_PRIORITY_meta-polarfire-soc-bsp = "1"

# This should only be incremented on significant changes that will
# cause compatibility issues with other layers
LAYERVERSION_meta-polarfire-soc-bsp = "1"

LAYERDEPENDS_meta-polarfire-soc-bsp = "core"
LAYERDEPENDS_meta-polarfire-soc-bsp += "openembedded-layer"

LAYERSERIES_COMPAT_meta-polarfire-soc-bsp = "honister kirkstone"
```

## meta-polarfire-soc-bsp/conf/machine/beaglev-fire.conf
```bitbake
#@TYPE: Machine
#@NAME: beaglev-fire
#@SOC: Polarfire SoC
#@DESCRIPTION: Machine configuration for the BeagleV-Fire

require include/mpfs-common.inc

MACHINE_TYPE = "smp"

RISCV_SBI_FDT ?=  "mpfs-beaglev-fire.dtb"
KERNEL_DTC_FLAGS += "-@"
KERNEL_DEVICETREE ?= "microchip/${RISCV_SBI_FDT}"

UBOOT_CONFIG = "beaglev-fire"
UBOOT_CONFIG[beaglev-fire] = "beaglev_fire_defconfig"

## Generate a boot.scr file which should be included
##  in the boot partition. It will try to load a kernel image from mmc
UBOOT_ENV = "boot"
UBOOT_ENV_SUFFIX = "scr"
UBOOT_ENV_SIZE = "0x2000"

HSS_PAYLOAD = "uboot"

IMAGE_BOOT_FILES ?= " \
    fitImage \
    boot.scr \
    uboot.env \
"

WKS_FILE ?= "mpfs-rootfs.wks"

MACHINEOVERRIDES =. "icicle-kit:"

# Configure preferred version to match with
# Not compatible with libgpiod v2
#
PREFERRED_VERSION_libgpiod = "1.6.4"
```

## meta-polarfire-soc-bsp/conf/machine/icicle-kit-es-nand.conf
```bitbake
#@TYPE: Machine
#@NAME: icicle-kit-es-nand
#@SOC: Polarfire SoC
#@DESCRIPTION: Machine configuration for the Microchip Polarfire SoC, Icicle Kit Engineering Sample

require include/mpfs-common.inc

MACHINE_TYPE = "smp"

RISCV_SBI_FDT ?=  "mpfs-icicle-kit.dtb"
KERNEL_DTC_FLAGS += "-@"
KERNEL_DEVICETREE ?= "microchip/${RISCV_SBI_FDT}"

UBOOT_CONFIG = "mpfs_icicle"
UBOOT_CONFIG[mpfs_icicle] = "microchip_mpfs_icicle_defconfig"

# UBIFS for Mikroe FLash 5 Click (128 MB)
MKUBIFS_ARGS ?= " -e 126976 -c 926 -m 2048 -x zlib -F"
UBINIZE_ARGS ?= " -m 2048 -p 128KiB -s 2048"
MKENVIMAGE_EXTRA_ARGS = " -r "

MPFS_MTDPARTS = "spi2.0:2m(payload),128k(env),119m(rootfs)"
MPFS_IS_ON_MTDID = "spi2.0"
MPFS_MTD_TYPE = "nand"
UBI_VOLNAME = "rootfs"

UBOOT_ENV = "boot"
UBOOT_ENV_SUFFIX = "scr"
UBOOT_ENV_SIZE = "0x2000"

HSS_PAYLOAD = "uboot"

IMAGE_BOOT_FILES ?= " \
    fitImage \
    boot.scr \
"

WKS_FILE ?= "mpfs-rootfs.wks"

MACHINEOVERRIDES =. "icicle-kit:"
```

## wic/mpfs-fsbl-opensbi.wks
```
# short-description: Create SD card image for HiFive Unleashed development board with FSBL and OpenSBI

part /boot --source bootimg-partition --ondisk mmcblk0 --fstype=vfat --label boot --active --size=100M --align 4096
part fsbl --source rawcopy --sourceparams="file=fsbl.bin" --ondisk mmcblk0 --fixed-size 32K --align 1 --part-type 5b193300-fc78-40cd-8002-e86c45580b47
part opensbi --source rawcopy --sourceparams="file=fw_payload.bin" --ondisk mmcblk0 --fixed-size 8M --align 1 --part-type 2e54b353-1271-4842-806f-e436d6af6985
part / --source rootfs --ondisk mmcblk0 --fstype=ext4 --label root --align 4096 --size 5G

bootloader --ptable gpt
```

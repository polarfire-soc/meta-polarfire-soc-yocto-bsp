## meta-polarfire-soc-bsp/conf/machine/icicle-kit-es-nor.conf
```bitbake
#@TYPE: Machine
#@NAME: icicle-kit-es-nor
#@SOC: Polarfire SoC
#@DESCRIPTION: Machine configuration for the Microchip Polarfire SoC, Icicle Kit Engineering Sample

require include/mpfs-common.inc

MACHINE_TYPE = "smp"

RISCV_SBI_FDT ?=  "mpfs-icicle-kit.dtb"
KERNEL_DTC_FLAGS += "-@"
KERNEL_DEVICETREE ?= "microchip/${RISCV_SBI_FDT}"

UBOOT_CONFIG = "mpfs_icicle"
UBOOT_CONFIG[mpfs_icicle] = "microchip_mpfs_icicle_qspi_nor_defconfig"

# UBIFS for PMOD SF3 NOR Flash + Pmod HAT Adapter (32 MB)
MKUBIFS_ARGS ?= " -e 65408 -c 422 -m 1 -x zlib"

# The 32MB PMOD SF3 NOR Flash is too small for latest systemd versions
# use sysvinit for this machine only. This can be commented for
# other NOR flashes with larger capacity.
DISTRO_FEATURES:remove = " systemd"
DISTRO_FEATURES:append = " sysvinit"
VIRTUAL-RUNTIME_init_manager = "sysvinit"
VIRTUAL-RUNTIME_initscripts = "initscripts"
VIRTUAL-RUNTIME_login_manager = "busybox"
VIRTUAL-RUNTIME_base-utils-hwclock = "util-linux-hwclock"

# Used by sysvinit
SERIAL_CONSOLES = "115200;ttyS1"

UBINIZE_ARGS ?= " -m 1 -p 64KiB"

MPFS_MTDPARTS = "spi2.0:2m(payload),28m(ubi)"
MPFS_IS_ON_MTDID = "spi2.0"
MPFS_MTD_TYPE = "nor"
UBI_VOLNAME = "ubi"

IMAGE_CLASSES:append = " image_type_mtd image_type-ubimage"
IMAGE_FSTYPES = "  mtd ubifs ubimg"
UBI_ROOTFS_SIZE = "16"

UBOOT_ENV = "boot"
UBOOT_ENV_SUFFIX = "scr"
UBOOT_ENV_SIZE = "0x2000"

HSS_PAYLOAD = "uboot"

IMAGE_BOOT_FILES ?= " \
    fitImage \
    boot.scr \
"

WKS_FILE ?= "mpfs-rootfs.wks"

MACHINEOVERRIDES =. "icicle-kit:"
```

## meta-polarfire-soc-bsp/conf/machine/icicle-kit-es.conf
```bitbake
#@TYPE: Machine
#@NAME: icicle-kit-es
#@SOC: Polarfire SoC
#@DESCRIPTION: Machine configuration for the Microchip Polarfire SoC, Icicle Kit Engineering Sample

require include/mpfs-common.inc

MACHINE_TYPE = "smp"

RISCV_SBI_FDT ?=  "mpfs-icicle-kit.dtb"
KERNEL_DTC_FLAGS += "-@"
KERNEL_DEVICETREE ?= "microchip/${RISCV_SBI_FDT}"

UBOOT_CONFIG = "mpfs_icicle"
UBOOT_CONFIG[mpfs_icicle] = "microchip_mpfs_icicle_defconfig"

## Generate a boot.scr file which should be included
##  in the boot partition. It will try to load a kernel image from mmc
UBOOT_ENV = "boot"
UBOOT_ENV_SUFFIX = "scr"
UBOOT_ENV_SIZE = "0x2000"

HSS_PAYLOAD = "uboot"

IMAGE_BOOT_FILES ?= " \
    fitImage \
    boot.scr \
"

WKS_FILE ?= "mpfs-rootfs.wks"

MACHINEOVERRIDES =. "icicle-kit:"
```

## meta-polarfire-soc-bsp/conf/machine/mpfs-video-kit.conf
```bitbake
#@TYPE: Machine
#@NAME: mpfs-video-kit
#@SOC: Polarfire SoC
#@DESCRIPTION: Machine configuration for the Microchip Polarfire SoC Video Kit

require include/mpfs-common.inc
MACHINE_TYPE = "smp"

RISCV_SBI_FDT ?=  "mpfs-video-kit.dtb"
KERNEL_DTC_FLAGS += "-@"
KERNEL_DEVICETREE ?= "microchip/${RISCV_SBI_FDT}"

UBOOT_MACHINE="microchip_mpfs_videokit_defconfig"
UBOOT_DEVICE_TREE ?= "mpfs_video.dtb"

## Set this to "mmc-tftp" to generate a boot.scr file which should be included
##  in the boot partition. It will try to load a kernel image from mmc and fall back to tftp
UBOOT_ENV = "tftp-mmc"

HSS_PAYLOAD = "uboot"

IMAGE_BOOT_FILES ?= " \
    fitImage \
    boot.scr.uimg \
"

WKS_FILE ?= "mpfs-rootfs.wks"
```

## meta-polarfire-soc-community/conf/layer.conf
```bitbake
# We have a conf and classes directory, add to BBPATH
BBPATH .= ":${LAYERDIR}"

# We have recipes-* directories, add to BBFILES
BBFILES += "${LAYERDIR}/recipes-*/*/*.bb ${LAYERDIR}/recipes-*/*/*.bbappend"


BBFILE_COLLECTIONS += "meta-polarfire-soc-community"
BBFILE_PATTERN_meta-polarfire-soc-community = "^${LAYERDIR}/"
BBFILE_PRIORITY_meta-polarfire-soc-community = "6"

# This should only be incremented on significant changes that will
# cause compatibility issues with other layers
LAYERVERSION_meta-polarfire-soc-community = "1"

LAYERDEPENDS_meta-polarfire-soc-community = "meta-polarfire-soc-bsp"

LAYERSERIES_COMPAT_meta-polarfire-soc-community = "honister kirkstone"
```

## meta-polarfire-soc-community/conf/machine/beaglev-fire.conf
```bitbake
#@TYPE: Machine
#@NAME: beaglev-fire
#@SOC: beaglev-fire
#@DESCRIPTION: Machine configuration for the BeagleV Fire board

require ../../../meta-polarfire-soc-bsp/conf/machine/include/mpfs-common.inc
 
MACHINE_TYPE = "smp"
 
RISCV_SBI_FDT ?= "mpfs-beaglev-fire.dtb"
KERNEL_DTC_FLAGS += "-@"
KERNEL_DEVICETREE ?= "microchip/${RISCV_SBI_FDT}"
 
UBOOT_CONFIG = "beaglev-fire"
UBOOT_CONFIG[beaglev-fire] = "beaglev_fire_defconfig"

UBOOT_ENV = "boot"
UBOOT_ENV_SUFFIX = "scr"
UBOOT_ENV_SIZE = "0x2000"

HSS_PAYLOAD = "uboot"

IMAGE_BOOT_FILES ?= " \
    fitImage \
    boot.scr \
    uboot.env \
"

WKS_FILE ?= "mpfs-rootfs.wks"
```

## meta-polarfire-soc-extras/conf/layer.conf
```bitbake
# We have a conf and classes directory, add to BBPATH
BBPATH .= ":${LAYERDIR}"

# We have recipes-* directories, add to BBFILES
BBFILES += "${LAYERDIR}/recipes-*/*/*.bb ${LAYERDIR}/recipes-*/*/*.bbappend"


BBFILE_COLLECTIONS += "meta-polarfire-soc-extras"
BBFILE_PATTERN_meta-polarfire-soc-extras = "^${LAYERDIR}/"
BBFILE_PRIORITY_meta-polarfire-soc-extras = "6"

# This should only be incremented on significant changes that will
# cause compatibility issues with other layers
LAYERVERSION_meta-polarfire-soc-extras = "1"

LAYERDEPENDS_meta-polarfire-soc-extras = "meta-polarfire-soc-bsp"

LAYERSERIES_COMPAT_meta-polarfire-soc-extras = "scarthgap styhead"
```

## meta-polarfire-soc-extras/conf/machine/icicle-kit-es-auth.conf
```bitbake
#@TYPE: Machine
#@NAME: icicle-kit-es
#@SOC: Polarfire SoC
#@DESCRIPTION: Machine configuration for the Microchip Polarfire SoC, Icicle Kit Engineering Sample

require conf/machine/include/mpfs-common.inc

MACHINE_TYPE = "smp"

RISCV_SBI_FDT ?=  "mpfs-icicle-kit.dtb"
KERNEL_DTC_FLAGS += "-@"
KERNEL_DEVICETREE ?= "microchip/${RISCV_SBI_FDT}"

UBOOT_CONFIG = "mpfs_icicle"
UBOOT_CONFIG[mpfs_icicle] = "microchip_mpfs_icicle_defconfig"

##UBOOT_ENV = "tftp-mmc"

HSS_PAYLOAD = "uboot"

UBOOT_SIGN_ENABLE = "1"
UBOOT_SIGN_KEYNAME ?= "mpfs_fitimage_key"
UBOOT_SIGN_KEYDIR ?= "${TOPDIR}/../keys"
UBOOT_MKIMAGE_DTCOPTS = "-I dts -O dtb -p 2000"
FIT_SIGN_ALG = "rsa4096"
FIT_HASH_ALG = "sha256"

HSS_PAYLOAD_PRIVATE_KEYNAME ?= "x509-ec-secp384r1-private"
HSS_PAYLOAD_KEYDIR ?= "${TOPDIR}/../keys"

IMAGE_BOOT_FILES ?= " \
    fitImage \
"

WKS_FILE ?= "mpfs-rootfs.wks"

MACHINEOVERRIDES =. "icicle-kit:"
```

## recipes-kernel/linux/files/icicle-kit-es-amp/defconfig
```kconfig
CONFIG_CMDLINE_BOOL=y
CONFIG_CMDLINE="earlycon=sbi root=/dev/mmcblk0p3 rootwait console=ttyS0,115200n8 uio_pdrv_genirq.of_id=generic-uio clk_ignore_unused"

CONFIG_RISCV_SBI=y
CONFIG_SYSVIPC=y
CONFIG_SYSFS=y
CONFIG_POSIX_MQUEUE=y
CONFIG_NO_HZ_IDLE=y
CONFIG_HIGH_RES_TIMERS=y
CONFIG_IKCONFIG=y
CONFIG_IKCONFIG_PROC=y
CONFIG_CGROUPS=y
CONFIG_CGROUP_SCHED=y
CONFIG_CFS_BANDWIDTH=y
CONFIG_CGROUP_BPF=y
CONFIG_NAMESPACES=y
CONFIG_USER_NS=y
CONFIG_EXPERT=y
CONFIG_BPF_SYSCALL=y
CONFIG_SOC_MICROCHIP_POLARFIRE=y
CONFIG_SMP=y
CONFIG_JUMP_LABEL=y
CONFIG_MODULES=y
CONFIG_MODULE_UNLOAD=y
CONFIG_NET=y
CONFIG_ETHERNET=y
CONFIG_EPOLL=y
CONFIG_PACKET=y
CONFIG_UNIX=y
CONFIG_INET=y
CONFIG_NETLINK_DIAG=y
CONFIG_HAS_DMA=y
CONFIG_DMADEVICES=y
CONFIG_ZONE_DMA=y
CONFIG_SWIOTLB=y
CONFIG_DNOTIFY=y
CONFIG_FANOTIFY=y
CONFIG_SIGNALFD=y
CONFIG_FILE_LOCKING=y
CONFIG_INOTIFY_USER=y
CONFIG_INPUT_EVDEV=y
CONFIG_IRQCHIP=y
CONFIG_KALLSYMS_ALL=y
CONFIG_KALLSYMS=y
CONFIG_TRACEPOINTS=y

CONFIG_PCI=y
CONFIG_PCI_DEBUG=y
CONFIG_PCI_DOMAINS=y
CONFIG_PCI_DOMAINS_GENERIC=y
CONFIG_PCI_ECAM=y
CONFIG_PCI_HOST_COMMON=y
CONFIG_PCI_HOST_GENERIC=y
CONFIG_PCI_MSI=y
CONFIG_PCI_MSI_IRQ_DOMAIN=y
CONFIG_PCI_QUIRKS=y
CONFIG_PCIE_MICROCHIP_HOST=y

CONFIG_RD_GZIP=y
CONFIG_DEVTMPFS=y
CONFIG_DEVTMPFS_MOUNT=y
CONFIG_BLOCK=y
CONFIG_BLK_DEV_INITRD=y
CONFIG_BLK_DEV_ZONED=y
CONFIG_BLK_DEV_NVME=y
CONFIG_BLK_DEV_NBD=y
CONFIG_BLK_DEV_LOOP=y
CONFIG_BLK_DEV_SD=y
CONFIG_BLK_DEV_SR=y
CONFIG_ATA=y
CONFIG_NETDEVICES=y
CONFIG_NET_VENDOR_CADENCE=y
CONFIG_NET_VENDOR_REALTEK=y
CONFIG_ARCH_DMA_ADDR_T_64BIT=y
CONFIG_MACB=y
CONFIG_MACB_USE_HWSTAMP=n
CONFIG_R8169=y
CONFIG_INPUT_MOUSEDEV=y
CONFIG_SERIAL_8250=y
CONFIG_SERIAL_8250_CONSOLE=y
CONFIG_SERIAL_OF_PLATFORM=y
CONFIG_SERIAL_EARLYCON_RISCV_SBI=y
CONFIG_HW_RANDOM=y
CONFIG_SPI=y
CONFIG_SPI_SIFIVE=y
CONFIG_SPI_MICROSEMI=y
CONFIG_SPI_MICROSEMI_QSPI=y
CONFIG_SPI_MASTER=y
CONFIG_GPIOLIB=y
CONFIG_GPIOLIB_IRQCHIP=y
CONFIG_GPIO_SYSFS=y
CONFIG_OF_GPIO=y
CONFIG_GPIO_MICROSEMI=y
CONFIG_PTP_1588_CLOCK=n
CONFIG_POWER_RESET=y
CONFIG_DRM=y
CONFIG_DRM_RADEON=y
CONFIG_DRM_NOUVEAU=y
CONFIG_FRAMEBUFFER_CONSOLE=y
CONFIG_V4L_PLATFORM_DRIVERS=y
CONFIG_USB=y
CONFIG_USB_ACM=y
CONFIG_USB_SERIAL=y
CONFIG_USB_XHCI_HCD=y
CONFIG_USB_XHCI_PLATFORM=y
CONFIG_USB_EHCI_HCD=y
CONFIG_USB_EHCI_HCD_PLATFORM=y
CONFIG_USB_OHCI_HCD=y
CONFIG_USB_OHCI_HCD_PLATFORM=y
CONFIG_USB_STORAGE=y
CONFIG_USB_SUPPORT=y
CONFIG_USB_INVENTRA_DMA=y
CONFIG_USB_MUSB_HDRC=y
CONFIG_USB_MUSB_HOST=y
CONFIG_NOP_USB_XCEIV=y
CONFIG_MEDIA_SUPPORT=y
CONFIG_MEDIA_CAMERA_SUPPORT=y
CONFIG_MEDIA_USB_SUPPORT=y
CONFIG_USB_VIDEO_CLASS=y
CONFIG_USB_MUSB_MPFS_MICROCHIP=y
CONFIG_NLS_ASCII=y
CONFIG_NLS_CODEPAGE_437=y
CONFIG_NLS_CODEPAGE_850=y
CONFIG_NLS_ISO8859_1=y
CONFIG_NLS_UTF8=y
CONFIG_MMC_SDHCI=y
CONFIG_MMC_SDHCI_PLTFM=y
CONFIG_MMC_SDHCI_CADENCE=y
CONFIG_MMC=y
CONFIG_MMC_SPI=y
CONFIG_MMC_BLOCK_MINORS=8
CONFIG_MMC_BLOCK=y
CONFIG_MTD_BLOCK=y
CONFIG_MTD_CFI_AMDSTD=y
CONFIG_MTD_CFI_INTELEXT=y
CONFIG_MTD_CFI_STAA=y
CONFIG_MTD_CFI=y
CONFIG_MTD_M25P80=y
CONFIG_MTD_PHYSMAP=y
CONFIG_MTD_SPI_NOR=y
CONFIG_RTC_CLASS=y
CONFIG_RTC_DRV_MPFS=y
CONFIG_PWM=y
CONFIG_PWM_MICROCHIP_CORE=y
CONFIG_SF_PDMA=y
CONFIG_SHMEM=y
CONFIG_EXT4_FS=y
CONFIG_EXT4_FS_POSIX_ACL=y
CONFIG_EXFAT_DEFAULT_IOCHARSET="utf8"
CONFIG_EXFAT_FS=y
CONFIG_FAT_DEFAULT_CODEPAGE=437
CONFIG_FAT_DEFAULT_IOCHARSET="ascii"
CONFIG_FAT_FS=y
CONFIG_MSDOS_FS=y
CONFIG_MSDOS_PARTITION=y
CONFIG_VFAT_FS=y
CONFIG_TMPFS=y
CONFIG_TMPFS_POSIX_ACL=y
CONFIG_EFI_PARTITION=y
CONFIG_PARTITION_ADVANCED=y
CONFIG_NFS_FS=y
CONFIG_NFS_V4=y
CONFIG_NFS_V4_1=y
CONFIG_NFS_V4_2=y
CONFIG_ROOT_NFS=y
CONFIG_PROC_FS=y
CONFIG_PROC_PAGE_MONITOR=y
CONFIG_PRINTK_TIME=y
CONFIG_SCHED_STACK_END_CHECK=y
CONFIG_SCHEDSTATS=y
CONFIG_SOFTLOCKUP_DETECTOR=y
CONFIG_WQ_WATCHDOG=y
CONFIG_DEBUG_SPINLOCK=y
CONFIG_STACKTRACE=y

CONFIG_CPU_FREQ_DEFAULT_GOV_USERSPACE=y
CONFIG_CPU_FREQ_GOV_ATTR_SET=y
CONFIG_CPU_FREQ_GOV_COMMON=y
CONFIG_CPU_FREQ_GOV_USERSPACE=y
CONFIG_CPU_FREQ=y
CONFIG_CPU_IDLE=y
CONFIG_CPUFREQ_DT=y

CONFIG_MAILBOX=y
CONFIG_POLARFIRE_SOC_MAILBOX=y
CONFIG_POLARFIRE_SOC_SYS_CTRL=y
CONFIG_POLARFIRE_SOC_GENERIC_SERVICE=y
CONFIG_HW_RANDOM=y
CONFIG_HW_RANDOM_POLARFIRE_SOC=y

CONFIG_I2C=y
CONFIG_I2C_CHARDEV=y
CONFIG_I2C_MICROCHIP=y
CONFIG_PAC193X=y
CONFIG_IIO_BUFFER=y
CONFIG_IIO_CONFIGFS=y
CONFIG_IIO_CONSUMERS_PER_TRIGGER=2
CONFIG_IIO_KFIFO_BUF=y
CONFIG_IIO_SW_DEVICE=y
CONFIG_IIO_SW_TRIGGER=y
CONFIG_IIO_TRIGGERED_BUFFER=y
CONFIG_IIO_TRIGGER=y
CONFIG_IIO=y

CONFIG_U_DMA_BUF=y
CONFIG_UIO=y
CONFIG_UIO_PDRV_GENIRQ=y
CONFIG_UIO_DMEM_GENIRQ=y
CONFIG_UIO_MICROCHIP_CAN=y
CONFIG_UIO_MICROCHIP_PDMA=y
CONFIG_UIO_MICROSEMI_DMA=y

CONFIG_RPMSG=y
CONFIG_RPMSG_CHAR=m
CONFIG_MIV_IHC=y
CONFIG_RPMSG_MIV=y
CONFIG_RPMSG_MIV_TTY=m
CONFIG_RPMSG_VIRTIO=y
```

## recipes-kernel/linux/files/lc-mpfs/defconfig
```kconfig
CONFIG_CMDLINE="debug console=tty0 console=ttySIF0 rootwait root=/dev/mmcblk0p4 uio_pdrv_genirq.of_id=generic-uio"
CONFIG_POLARFIRE_SOC=y
CONFIG_SYSVIPC=y
CONFIG_POSIX_MQUEUE=y
CONFIG_NO_HZ_IDLE=y
CONFIG_HIGH_RES_TIMERS=y
CONFIG_IKCONFIG=y
CONFIG_IKCONFIG_PROC=y
CONFIG_CGROUPS=y
CONFIG_CGROUP_SCHED=y
CONFIG_CFS_BANDWIDTH=y
CONFIG_CGROUP_BPF=y
CONFIG_NAMESPACES=y
CONFIG_USER_NS=y
CONFIG_CHECKPOINT_RESTORE=y
CONFIG_BLK_DEV_INITRD=y
CONFIG_EXPERT=y
CONFIG_BPF_SYSCALL=y
CONFIG_SOC_SIFIVE=y
CONFIG_SMP=y
CONFIG_MODULES=y
CONFIG_MODULE_UNLOAD=y
CONFIG_NET=y
CONFIG_PACKET=y
CONFIG_UNIX=y
CONFIG_INET=y
CONFIG_IP_MULTICAST=y
CONFIG_IP_ADVANCED_ROUTER=y
CONFIG_IP_PNP=y
CONFIG_IP_PNP_DHCP=y
CONFIG_IP_PNP_BOOTP=y
CONFIG_IP_PNP_RARP=y
CONFIG_NETLINK_DIAG=y
CONFIG_NET_9P=y
CONFIG_NET_9P_VIRTIO=y
# CONFIG_PCI is not set
# CONFIG_PCIEPORTBUS is not set
# CONFIG_PCI_HOST_GENERIC is not set
# CONFIG_PCIE_XILINX is not set
CONFIG_DEVTMPFS=y
CONFIG_DEVTMPFS_MOUNT=y
CONFIG_BLK_DEV_LOOP=y
CONFIG_VIRTIO_BLK=y
CONFIG_BLK_DEV_SD=y
CONFIG_BLK_DEV_SR=y
CONFIG_SCSI_VIRTIO=y
CONFIG_ATA=y
CONFIG_ATA_GENERIC=y
CONFIG_SATA_AHCI=y
CONFIG_SATA_AHCI_PLATFORM=y
CONFIG_SATA_MV=y
CONFIG_SATA_SIL=y
CONFIG_NETDEVICES=y
CONFIG_VIRTIO_NET=y
CONFIG_MACB=y
CONFIG_E1000E=y
CONFIG_R8169=y
CONFIG_MICROSEMI_PHY=y
CONFIG_INPUT_MOUSEDEV=y
CONFIG_SERIAL_8250=y
CONFIG_SERIAL_8250_CONSOLE=y
CONFIG_SERIAL_OF_PLATFORM=y
CONFIG_SERIAL_EARLYCON_RISCV_SBI=y
CONFIG_HVC_RISCV_SBI=y
CONFIG_VIRTIO_CONSOLE=y
CONFIG_HW_RANDOM=y
CONFIG_HW_RANDOM_VIRTIO=y
CONFIG_SPI=y
CONFIG_SPI_SIFIVE=y
# CONFIG_PTP_1588_CLOCK is not set
CONFIG_DRM=y
CONFIG_DRM_RADEON=y
CONFIG_DRM_VIRTIO_GPU=y
CONFIG_FRAMEBUFFER_CONSOLE=y
CONFIG_USB=y
CONFIG_USB_XHCI_HCD=y
CONFIG_USB_XHCI_PLATFORM=y
CONFIG_USB_EHCI_HCD=y
CONFIG_USB_EHCI_HCD_PLATFORM=y
CONFIG_USB_OHCI_HCD=y
CONFIG_USB_OHCI_HCD_PLATFORM=y
CONFIG_USB_STORAGE=y
CONFIG_USB_UAS=y
CONFIG_MMC=y
CONFIG_MMC_SPI=y
# CONFIG_VIRTIO_PCI is not set
CONFIG_VIRTIO_BALLOON=y
CONFIG_VIRTIO_INPUT=y
CONFIG_VIRTIO_MMIO=y
CONFIG_RPMSG_CHAR=y
CONFIG_RPMSG_VIRTIO=y
CONFIG_EXT4_FS=y
CONFIG_EXT4_FS_POSIX_ACL=y
CONFIG_AUTOFS4_FS=y
CONFIG_MSDOS_FS=y
CONFIG_VFAT_FS=y
CONFIG_TMPFS=y
CONFIG_TMPFS_POSIX_ACL=y
CONFIG_NFS_FS=y
CONFIG_NFS_V4=y
CONFIG_NFS_V4_1=y
CONFIG_NFS_V4_2=y
CONFIG_ROOT_NFS=y
CONFIG_9P_FS=y
CONFIG_CRYPTO_USER_API_HASH=y
CONFIG_CRYPTO_DEV_VIRTIO=y
CONFIG_PRINTK_TIME=y
# CONFIG_RCU_TRACE is not set
CONFIG_BLK_DEV_ZONED=y
CONFIG_OF=y
# CONFIG_PCI_DEBUG is not set
# CONFIG_PCIE_MICROSEMI is not set
# CONFIG_PCI_SW_SWITCHTEC is not set
# CONFIG_EXTRA_FIRMWARE is not set
CONFIG_BLK_DEV_NBD=y
CONFIG_BLK_DEV_NVME=y
CONFIG_NVME_MULTIPATH=y
CONFIG_NVME_FC=y
CONFIG_NVME_TARGET=y
CONFIG_NVME_TARGET_LOOP=y
CONFIG_NVME_TARGET_FC=y
CONFIG_NVME_TARGET_FCLOOP=y
CONFIG_NVME_TARGET_TCP=y
CONFIG_SATA_MV=y
CONFIG_SATA_SIL=y
CONFIG_TARGET_CORE=y
CONFIG_TCM_IBLOCK=y
CONFIG_TCM_FILEIO=y
CONFIG_ISCSI_TARGET=y
CONFIG_INPUT_EVDEV=y
# CONFIG_KEYBOARD_ATKBD is not set
# CONFIG_MOUSE_PS2 is not set
CONFIG_INPUT_TABLET=y
CONFIG_INPUT_TOUCHSCREEN=y
CONFIG_TOUCHSCREEN_USB_COMPOSITE=y
CONFIG_SERIO_LIBPS2=y
CONFIG_LOGO=y
CONFIG_SOUND=y
CONFIG_SND=y
CONFIG_SND_USB_AUDIO=y
CONFIG_DMADEVICES=y
CONFIG_CLK_SIFIVE=y
CONFIG_CLK_SIFIVE_FU540_PRCI=y
CONFIG_SIFIVE_PLIC=y
CONFIG_EXT4_FS=y
CONFIG_EXT3_FS=y
CONFIG_F2FS_FS=y
CONFIG_F2FS_FS_SECURITY=y
CONFIG_FUSE_FS=m
CONFIG_USB_ACM=y
CONFIG_USB_SERIAL=y
CONFIG_EMBEDDED=y

CONFIG_ARCH_RISCVPC=y
CONFIG_USB_SUPPORT=y
CONFIG_USB_INVENTRA_DMA=y
CONFIG_USB_MUSB_HDRC=y
CONFIG_USB_MUSB_HOST=y
CONFIG_USB_MUSB_MICROSEMI=y

CONFIG_UIO=y
CONFIG_UIO_PDRV_GENIRQ=y
CONFIG_UIO_DMEM_GENIRQ=y
CONFIG_UIO_MICROSEMI_CAN=y

CONFIG_I2C_OCORES=y
CONFIG_I2C_CHARDEV=y
CONFIG_I2C_MICROSEMI=y

CONFIG_SPI_MICROSEMI_QSPI=y
CONFIG_SPI_MICROSEMI=y
CONFIG_SPI_MASTER=y
CONFIG_SPI_SPIDEV=y
CONFIG_GPIOLIB=y
CONFIG_GPIOLIB_IRQCHIP=y

CONFIG_OF_GPIO=y
CONFIG_GPIO_SIFIVE=y
CONFIG_GPIO_MICROSEMI=y

CONFIG_PWM_SIFIVE=y
CONFIG_PWM=y
CONFIG_LEDS_PWM=y
CONFIG_REGULATOR_PWM=y
CONFIG_PWM_SYSFS=y
CONFIG_COMMON_CLK_PWM=y

CONFIG_MTD=y
CONFIG_MTD_SPI_NOR=y
CONFIG_MTD_BLKDEVS=y
CONFIG_MTD_BLOCK=y
CONFIG_MTD_CFI=y
CONFIG_MTD_CFI_AMDSTD=y
CONFIG_MTD_CFI_INTELEXT=y
CONFIG_MTD_CFI_STAA=y
CONFIG_MTD_PHYSMAP=y

CONFIG_EDAC=y
CONFIG_EDAC_LEGACY_SYSFS=y
CONFIG_EDAC_SIFIVE=y
```
